/*
 * fuel_and_temp.c
 *
 *  Created on: 14 sie 2026
 *      Author: rataj
 */
#include "main.h"
#include "mcp4661.h"

extern I2C_HandleTypeDef hi2c1;

//-------------- FUEL LUT------------------------
static const uint8_t fuel_raw_lut[101] = {
	44,  44,  44,  45,  45,  46,  46,  46,  47,  47, //  0% - 9%
	47,  48,  48,  49,  49,  50,  50,  51,  51,  52, // 10% - 19%
	52,  53,  53,  54,  54,  55,  55,  56,  56,  57, // 20% - 29%
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	90,  90,  91,  91,  91,  91,  92,  92,  92,  92, // 90% - 99%
	92                                      // 100%
};
//-----------------------------------------------

//-------------------TEMP LUT -----------------------------------
static const uint8_t temp_raw_lut[101] = {
		33, 34, 35, 36, 37, 37, 38, 39, 40, 41, //  0% - 9%
		42, 42, 43, 44, 45, 46, 46, 47, 48, 49, // 10% - 19%
		50, 50, 51, 52, 52, 53, 53, 54, 54, 55, // 20% - 29%
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		109, 109, 109, 110, 110, 110, 111, 111, 111, 112, // 90% - 99%
		112                                                // 100%
};
//-------------------------------------------------------------------

void Send_Engine_Temperature(uint8_t temp_lvl_pct){

	if (temp_lvl_pct > 100) {
		temp_lvl_pct = 100;
	}

	uint8_t temp_lvl_raw = temp_raw_lut[temp_lvl_pct];

	if (hi2c1.State != HAL_I2C_STATE_READY) {
	        HAL_I2C_DeInit(&hi2c1);
	        HAL_I2C_Init(&hi2c1);
	}

	MCP4661_SetWiper(&hi2c1, MCP4661_VOLATILE_WIPER_0, temp_lvl_raw);
}

void Send_Fuel_lvl(uint8_t fuel_lvl_pct){

	if (fuel_lvl_pct > 100) {
		fuel_lvl_pct = 100;
	}

	uint8_t fuel_lvl_raw = fuel_raw_lut[fuel_lvl_pct];

	if (hi2c1.State != HAL_I2C_STATE_READY) {
	        HAL_I2C_DeInit(&hi2c1);
	        HAL_I2C_Init(&hi2c1);
	}

	MCP4661_SetWiper(&hi2c1, MCP4661_VOLATILE_WIPER_1, fuel_lvl_raw);
}
